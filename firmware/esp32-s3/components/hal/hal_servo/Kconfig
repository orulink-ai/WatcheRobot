## firmware/esp32-s3/components/hal/hal_servo/Kconfig
```kconfig
menu "Watcher HAL Servo"

    comment "GPIO19/GPIO20 are owned by the mcu_link runtime UART in v2"

    config WATCHER_SERVO_MOTION_ENABLE
        bool "Enable coprocessor servo motion output"
        default n
        help
            Enable forwarding servo commands to the STM32 coprocessor motion
            service. Leave disabled while testing voice wake word detection to
            avoid MCU_MOTION traffic and servo movement.

    config WATCHER_SERVO_Y_MIN_DEG
        int "Servo Y axis minimum angle (degrees)"
        default 100
        range 0 180
        help
            Mechanical protection lower limit for Y axis (prevents hardware damage).

    config WATCHER_SERVO_Y_MAX_DEG
        int "Servo Y axis maximum angle (degrees)"
        default 140
        range 0 180
        help
            Mechanical protection upper limit for Y axis.

endmenu
```

## firmware/esp32-s3/components/protocols/realtime_client/Kconfig
```kconfig
menu "Watcher Realtime Agent Client"

    config WATCHER_AGENT_REALTIME_URL
        string "Agent Realtime WebSocket URL"
        default "ws://192.168.1.130:8776/v1/realtime"
        help
            OpenAI Realtime-compatible WebSocket endpoint exposed by the local
            Hugging Face speech-to-speech service on Spark.

    config WATCHER_AGENT_API_KEY
        string "Agent Realtime API key"
        default "not-needed"
        help
            API key value sent through the WebSocket Authorization header when
            configured. The local Spark deployment accepts not-needed.

    config WATCHER_AGENT_VOICE
        string "Agent Realtime voice"
        default "Aiden"
        help
            Voice name sent in session.update. The Spark canary currently uses
            Qwen3-TTS CustomVoice speaker Aiden.

    config WATCHER_AGENT_CONNECT_TIMEOUT_MS
        int "Agent Realtime connect timeout (ms)"
        default 10000
        range 1000 60000

    config WATCHER_AGENT_RESPONSE_TIMEOUT_MS
        int "Agent Realtime response timeout (ms)"
        default 30000
        range 5000 120000

    config WATCHER_AGENT_AUDIO_QUEUE_DEPTH
        int "Agent TTS playback queue depth"
        default 32
        range 4 64
        help
            Number of decoded Realtime audio chunks buffered in PSRAM before
            playback. Larger queues tolerate bursty TTS delivery.

    config WATCHER_AGENT_AUDIO_GAIN_Q8
        int "Agent TTS playback PCM gain (Q8)"
        default 362
        range 256 512
        help
            Fixed-point playback gain applied to decoded TTS PCM before it is
            sent to the codec. 256 means 1.0x; 362 is about +3 dB.

    config WATCHER_AGENT_AUDIO_TAIL_PAD_MS
        int "Agent TTS playback tail silence padding (ms)"
        default 100
        range 0 500
        help
            Silence appended after the final TTS chunk so the codec/I2S path
            is not closed before the audible tail drains.

    config WATCHER_AGENT_AUDIO_DRAIN_MS
        int "Agent TTS playback drain guard (ms)"
        default 120
        range 0 500
        help
            Delay after tail padding before the playback path enters idle.
            This gives hardware buffers time to finish the last samples.

endmenu
```

## firmware/esp32-s3/components/protocols/ws_client/Kconfig
```kconfig
menu "Watcher WebSocket Client"

    config WATCHER_WS_AUDIO_UPLINK_OPUS
        bool "Advertise Opus microphone uplink"
        default y
        help
            Advertise and use 16 kHz mono 60 ms Opus packets only after the
            server explicitly selects Opus in the sys.client.hello ACK. PCM is
            always retained as a compatibility fallback.

    config WATCHER_WS_AUDIO_QUEUE_DEPTH
        int "Audio upload queue depth"
        default 128
        range 8 128
        help
            Number of 1920-byte audio upload frames staged in PSRAM. The
            uploader normally sends two-frame batches and raises that to four
            frames under queue or latency pressure. One hundred twenty-eight
            slots provide about 7.7 seconds of headroom for transient Wi-Fi
            retransmission stalls without consuming scarce internal RAM.

    config WATCHER_WS_AUDIO_STATS_LOG_INTERVAL_FRAMES
        int "Audio upload stats log interval"
        default 60
        range 0 1000
        help
            Emit one websocket audio upload stats log every N sent frames.
            Set to 0 to disable periodic audio upload stats logs.

    config WATCHER_WS_TTS_QUEUE_DEPTH
        int "TTS playback queue depth"
        default 64
        range 2 64
        help
            Number of 4096-byte TTS frames available for cloud speech
            playback. Sixty-four frames provide about 5.4 seconds of PSRAM
            buffering at 24kHz 16-bit mono, absorbing desktop/server TTS
            bursts without spending scarce internal DMA-capable memory.

    config WATCHER_WS_TTS_MAX_PAYLOAD_BYTES
        int "Maximum inbound TTS payload bytes"
        default 32768
        range 4096 65536
        help
            Maximum accepted WSPK audio payload from the desktop/server in one
            WebSocket message. Larger payloads are rejected before they can
            flood the playback queue.

    config WATCHER_WS_TTS_ENQUEUE_TIMEOUT_MS
        int "TTS enqueue backpressure timeout (ms)"
        default 1500
        range 100 5000
        help
            Maximum time a websocket receive callback waits for a free TTS
            playback slot before dropping the current inbound TTS chunk. The
            wait applies TCP backpressure when server-side TTS delivery is
            faster than local I2S playback.

    config WATCHER_WS_TTS_START_BUFFER_FRAMES
        int "TTS playback start buffer frames"
        default 16
        range 1 32
        help
            Number of 4096-byte TTS frames to buffer before starting cloud
            speech playback. Sixteen frames provide roughly 1.36 seconds of
            startup cushion at 24 kHz 16-bit mono. A short stream is still
            allowed to drain as soon as its LAST frame arrives.

    config WATCHER_WS_TTS_REBUFFER_FRAMES
        int "TTS playback recovery buffer frames"
        default 12
        range 1 32
        help
            Amount of real PCM audio to accumulate after playback starvation
            before resuming I2S writes. Twelve 4096-byte frames provide roughly
            1.02 seconds of recovery cushion. A short tail still drains when
            the stream LAST marker has arrived.

    config WATCHER_WS_TTS_STARVATION_WARN_MS
        int "TTS playback queue starvation warning (ms)"
        default 60
        range 0 1000
        help
            Log and count a playback queue starvation event when TTS playback
            is already active but no queued frame arrives for at least this
            many milliseconds. This catches audible stutter even when no
            frames are dropped.

    config WATCHER_WS_TTS_BUFFER_STATUS_INTERVAL_MS
        int "TTS buffer status uplink interval (ms)"
        default 200
        range 50 2000
        help
            Minimum interval between non-forced TTS playback buffer status
            events sent to the server. The server uses these watermarks to
            adapt audio downlink pacing without requiring per-frame ACKs.

    config WATCHER_WS_TTS_RX_LOG_INTERVAL_FRAMES
        int "TTS receive log interval"
        default 12
        range 0 1000
        help
            Emit one TTS receive log every N inbound audio messages, plus the
            first and last message. Set to 0 to log only first/last messages.

    config WATCHER_WS_TEXT_MAX_PAYLOAD_BYTES
        int "Maximum inbound text message bytes"
        default 8192
        range 1024 32768
        help
            Maximum accepted WebSocket text message size before JSON routing.
            Larger messages are rejected before allocating a full text buffer.

endmenu
```

## firmware/esp32-s3/components/services/anim_service/Kconfig
```kconfig
menu "Watcher Animation Service"

    config WATCHER_ANIM_FPS
        int "Animation frame rate (FPS)"
        default 10
        range 1 60
        help
            Target playback rate for the SD-backed animation streamer.
            Default 10fps balances smoothness with tighter ring-buffer safety.

    config WATCHER_ANIM_RING_FRAMES
        int "Animation ring buffer frames"
        default 4
        range 2 6
        help
            Number of decoded RGB565 frames kept in RAM for the active animation.
            Four frames provide deadline headroom for active playback while a
            second four-frame allocation is shared by staging and prefetch.

    config WATCHER_ANIM_ACTIVE_LOW_WATER_FRAMES
        int "Active playback low-water frames"
        default 1
        range 1 5
        help
            Prioritize active playback reads when its buffered frame count is
            at or below this threshold. The runtime clamps this value to the
            configured ring depth.

    config WATCHER_ANIM_STAGING_PREFILL_FRAMES
        int "Staging switch prefill frames"
        default 2
        range 1 6
        help
            Frames prepared for a staging animation before its first frame is
            committed. The runtime clamps this value to the staging ring depth.

    config WATCHER_ANIM_PREPARE_STALL_TIMEOUT_MS
        int "Animation prepare stall watchdog (ms)"
        default 2000
        range 100 10000
        help
            Failure watchdog for a staging request that makes no open/read
            progress. Expiry emits FAILED(PREPARE_STALLED); it never advances
            normal playback or pretends the request completed.

    config WATCHER_ANIM_DEBUG_PERF
        bool "Enable animation performance logging"
        default n
        help
            Log actual FPS and frame switching latency every 30 frames.
            Useful for debugging animation performance issues.

endmenu
```

## firmware/esp32-s3/components/services/sfx_service/Kconfig
```kconfig
menu "Watcher SFX Service"

    config WATCHER_SFX_TASK_STACK_SIZE
        int "SFX task stack size"
        default 6144
        range 3072 8192
        help
            Stack size for the local sound-effect playback task. The playback
            chunk defaults to 2KB; 6KB keeps headroom for SD/SPIFFS fallback,
            audio HAL transitions, and diagnostic snapshots.

    config WATCHER_SFX_STREAM_CHUNK_SIZE
        int "SFX stream chunk size"
        default 2048
        range 1024 4096
        help
            Bytes written to the audio HAL per local SFX streaming chunk.
            Lower values reduce task stack pressure with a small I/O overhead.

endmenu
```

## firmware/esp32-s3/components/services/voice_service/Kconfig
```kconfig
menu "Watcher Voice Service"

    config ENABLE_WAKE_WORD
        bool "Enable ESP-SR WakeNet wake word detection"
        default y
        depends on IDF_TARGET_ESP32S3 && SPIRAM
        help
            Enable local offline wake word detection through ESP-SR WakeNet.
            Audio is captured at 16 kHz mono while the recorder is idle.

    config VOICE_WAKE_WORD_RUNTIME_ENABLED
        bool "Enable Voice App standby WakeNet runtime"
        default y
        depends on ENABLE_WAKE_WORD
        help
            Enable the Voice App standby WakeNet runtime. The runtime is
            created only while Voice is idle/standby and destroyed before
            recording, cloud processing, or TTS playback to recover internal
            RAM and reduce contiguous heap pressure.

    config VOICE_WAKE_RESUME_MIN_INTERNAL_FREE_KB
        int "Minimum internal free heap before WakeNet standby resume"
        default 36
        range 0 256
        depends on VOICE_WAKE_WORD_RUNTIME_ENABLED
        help
            Skip rebuilding WakeNet in sleep standby if internal free heap is
            below this threshold. This prevents a low-memory sleep transition
            from making the system look idle while starving recording/TTS/UI.

    config VOICE_WAKE_RESUME_MIN_INTERNAL_LARGEST_KB
        int "Minimum internal largest block before WakeNet standby resume"
        default 12
        range 0 128
        depends on VOICE_WAKE_WORD_RUNTIME_ENABLED
        help
            Skip WakeNet resume when contiguous internal heap is already too
            fragmented for safe audio, UI, and protocol work.

    config VOICE_WAKE_RESUME_MIN_DMA_LARGEST_KB
        int "Minimum DMA largest block before WakeNet standby resume"
        default 12
        range 0 128
        depends on VOICE_WAKE_WORD_RUNTIME_ENABLED
        help
            Skip WakeNet resume when DMA-capable contiguous heap is already too
            fragmented for I2S/LCD-style allocations.

    config VAD_SILENCE_TIMEOUT_MS
        int "Wake-word recording silence timeout"
        default 1200
        depends on ENABLE_WAKE_WORD
        help
            Stop a wake-word-triggered recording after this much silence.

    config VAD_RMS_THRESHOLD
        int "Wake-word recording RMS silence threshold"
        default 450
        depends on ENABLE_WAKE_WORD
        help
            Frames below this RMS value are treated as silence.

    config VAD_MIN_SPEECH_MS
        int "Wake-word recording minimum speech duration"
        default 600
        depends on ENABLE_WAKE_WORD
        help
            Require this much detected speech before VAD can stop recording.

    config VOICE_TASK_STACK_SIZE
        int "Voice recorder task stack size"
        default 12288
        help
            Internal-RAM stack size for the lightweight recorder and VAD task.
            Opus encoding runs in the PSRAM-backed WebSocket audio worker.

    config WAKE_WORD_TASK_STACK_SIZE
        int "Wake word detection task stack size"
        default 4096
        depends on ENABLE_WAKE_WORD

    config WAKE_WORD_TASK_PRIORITY
        int "Wake word detection task priority"
        default 6
        depends on ENABLE_WAKE_WORD

    config VOICE_AUDIO_STATS_LOG_INTERVAL_FRAMES
        int "Recording audio stats log interval"
        default 60
        range 0 1000
        help
            Emit one recording audio stats log every N encoded frames. Set to
            0 to disable periodic recording audio stats logs.

    config WAKE_IDLE_STATS_LOG_INTERVAL_FRAMES
        int "Idle wake audio stats log interval"
        default 120
        range 0 2000
        depends on ENABLE_WAKE_WORD
        help
            Emit one idle wake-word audio stats log every N microphone frames.
            Set to 0 to disable periodic idle wake audio stats logs.

    choice WAKE_WORD_DET_MODE
        prompt "WakeNet detection sensitivity"
        default WAKE_WORD_DET_MODE_95
        depends on ENABLE_WAKE_WORD
        help
            DET_MODE_95 is more aggressive and improves wake probability, but
            may increase false wakeups in noisy environments.

        config WAKE_WORD_DET_MODE_90
            bool "DET_MODE_90 normal sensitivity"

        config WAKE_WORD_DET_MODE_95
            bool "DET_MODE_95 aggressive sensitivity"
    endchoice

endmenu
```

## firmware/esp32-s3/components/utils/time_sync_service/Kconfig
```kconfig
menu "Watcher Time Sync"

    config WATCHER_TIME_SYNC_DEFAULT_TZ
        string "Default POSIX timezone"
        default "CST-8"
        help
            Default POSIX TZ string used before user or server timezone settings
            exist. CST-8 means UTC+8 for China Standard Time.

    config WATCHER_TIME_SYNC_NTP_SERVER_1
        string "Primary NTP server"
        default "pool.ntp.org"

    config WATCHER_TIME_SYNC_NTP_SERVER_2
        string "Secondary NTP server"
        default "time.google.com"

endmenu
```
