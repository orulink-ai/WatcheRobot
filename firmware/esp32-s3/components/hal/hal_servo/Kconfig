## firmware/esp32-s3/sdkconfig.defaults
```kconfig
# ESP32-S3 configuration
CONFIG_IDF_TARGET="esp32s3"

# Flash
CONFIG_BOOTLOADER_CACHE_32BIT_ADDR_QUAD_FLASH=y
CONFIG_ESPTOOLPY_FLASH_MODE_AUTO_DETECT=n
CONFIG_ESPTOOLPY_FLASHMODE_QIO=y
CONFIG_ESPTOOLPY_FLASHSIZE_16MB=y
CONFIG_ESPTOOLPY_FLASHSIZE="16MB"

# ESP32-S3 Cache Configuration (CRITICAL for PSRAM performance)
CONFIG_ESP32S3_INSTRUCTION_CACHE_16KB=y
CONFIG_ESP32S3_INSTRUCTION_CACHE_8WAYS=y
CONFIG_ESP32S3_INSTRUCTION_CACHE_LINE_32B=y
CONFIG_ESP32S3_DATA_CACHE_32KB=y
CONFIG_ESP32S3_DATA_CACHE_8WAYS=y
CONFIG_ESP32S3_DATA_CACHE_LINE_32B=y

# PSRAM (required for audio buffers and LVGL)
CONFIG_SPIRAM=y
CONFIG_SPIRAM_MODE_OCT=y
CONFIG_SPIRAM_SPEED_80M=y
CONFIG_SPIRAM_MALLOC_ALWAYSINTERNAL=1024
CONFIG_SPIRAM_MALLOC_RESERVE_INTERNAL=262144
CONFIG_SPIRAM_ALLOW_BSS_SEG_EXTERNAL_MEMORY=y
CONFIG_SPIRAM_ALLOW_STACK_EXTERNAL_MEMORY=y
CONFIG_SPIRAM_TRY_ALLOCATE_WIFI_LWIP=y
CONFIG_SPIRAM_BOOT_INIT=y
CONFIG_SPIRAM_USE_MALLOC=y
CONFIG_SPIRAM_MEMTEST=y

# CPU
CONFIG_ESP_DEFAULT_CPU_FREQ_MHZ_240=y

# SPI Master
# CONFIG_SPI_MASTER_IN_IRAM is not set
CONFIG_SPI_MASTER_ISR_IN_IRAM=y

# WiFi
CONFIG_ESP_WIFI_ENABLED=y
CONFIG_ESP_WIFI_STATIC_RX_BUFFER_NUM=10
CONFIG_ESP_WIFI_RX_BA_WIN=6

# WiFi/BLE coexistence (required when BLE control and WiFi are both enabled)
CONFIG_ESP_COEX_SW_COEXIST_ENABLE=y

# Bluetooth LE (Bluedroid GATT Server for motion control)
CONFIG_BT_ENABLED=y
CONFIG_BT_CONTROLLER_ENABLED=y
CONFIG_BT_BLUEDROID_ENABLED=y
# CONFIG_BT_NIMBLE_ENABLED is not set
# CONFIG_BT_CLASSIC_ENABLED is not set
CONFIG_BT_BLE_ENABLED=y
CONFIG_BT_GATTS_ENABLE=y
CONFIG_BTDM_CTRL_MODE_BLE_ONLY=y
CONFIG_BT_BLE_42_FEATURES_SUPPORTED=y
CONFIG_BT_BLE_50_FEATURES_SUPPORTED=n

# Watcher BLE control + Wi-Fi provisioning service
CONFIG_WATCHER_BLE_ENABLE=y
CONFIG_WATCHER_BLE_DEVICE_NAME="ESP_ROBOT"
CONFIG_WATCHER_BLE_CMD_DEFAULT_DURATION_MS=300

# WebSocket
CONFIG_ESP_WEBSOCKET_CLIENT_ENABLED=y
CONFIG_ESP_WS_CLIENT_ENABLE_DYNAMIC_BUFFER=y

# I2S (audio)
CONFIG_ESP_I2S_ENABLED=y
CONFIG_BSP_AUDIO_DMA_BUFFER_SIZE=512
CONFIG_BSP_AUDIO_DMA_BUFFER_NUM=12
CONFIG_BSP_AUDIO_MIC_VALUE_GAIN=1

# FreeRTOS
CONFIG_FREERTOS_HZ=1000
CONFIG_FREERTOS_TIMER_TASK_STACK_DEPTH=1600

# Task stack sizes
CONFIG_ESP_SYSTEM_EVENT_TASK_STACK_SIZE=4096
CONFIG_ESP_MAIN_TASK_STACK_SIZE=16384
CONFIG_ESP_TIMER_TASK_STACK_SIZE=2600
CONFIG_ESP_INT_WDT_TIMEOUT_MS=10000
CONFIG_WATCHER_MCU_LINK_UART_ENABLE=y
CONFIG_WATCHER_MCU_LINK_UART_PORT_NUM=2
CONFIG_WATCHER_MCU_LINK_UART_TX_GPIO=19
CONFIG_WATCHER_MCU_LINK_UART_RX_GPIO=20
CONFIG_WATCHER_MCU_LINK_UART_BAUD_RATE=921600
CONFIG_WATCHER_MCU_LINK_UART_RX_BUFFER=4096
CONFIG_WATCHER_MCU_LINK_UART_TX_BUFFER=4096

# Keep BLE, Wi-Fi, and behavior servo control routed through the STM32 motion service.
CONFIG_WATCHER_SERVO_MOTION_ENABLE=y
CONFIG_WATCHER_SERVO_Y_MIN_DEG=100
CONFIG_WATCHER_SERVO_Y_MAX_DEG=140

# Log level
CONFIG_LOG_DEFAULT_LEVEL_INFO=y
CONFIG_BOOTLOADER_LOG_LEVEL_INFO=y
# CONFIG_LOG_COLORS is not set
CONFIG_WATCHER_RUNTIME_QUIET_LOGS=y
CONFIG_WATCHER_LOG_HEAP_DIAGNOSTICS=n
CONFIG_WATCHER_CAMERA_VERBOSE_LOGS=n
CONFIG_WATCHER_WIFI_REASON_NAME_LOGS=n
CONFIG_WATCHER_MEM_MONITOR_ENABLE=y
CONFIG_WATCHER_MEM_MONITOR_PERIOD_MS=15000
CONFIG_WATCHER_MEM_MONITOR_TASK_STACK_SIZE=4096
CONFIG_WATCHER_MEM_MONITOR_ALERT_REPEAT_MS=60000
CONFIG_WATCHER_MEM_MONITOR_LOG_STAGE_SNAPSHOTS=y
CONFIG_WATCHER_MEM_MONITOR_WARN_INTERNAL_FREE_KB=40
CONFIG_WATCHER_MEM_MONITOR_WARN_INTERNAL_LARGEST_KB=16
CONFIG_WATCHER_MEM_MONITOR_CRITICAL_INTERNAL_FREE_KB=28
CONFIG_WATCHER_MEM_MONITOR_CRITICAL_INTERNAL_LARGEST_KB=12
CONFIG_WATCHER_MEM_MONITOR_WARN_DMA_LARGEST_KB=16
CONFIG_WATCHER_MEM_MONITOR_CRITICAL_DMA_LARGEST_KB=12
CONFIG_WATCHER_MEM_MONITOR_CHECK_INTEGRITY_ON_CRITICAL=n

# Watchdog
CONFIG_ESP_TASK_WDT_INIT=y
CONFIG_ESP_TASK_WDT_TIMEOUT_S=30

# Console
CONFIG_ESP_CONSOLE_SECONDARY_NONE=y

# LWIP
CONFIG_LWIP_LOCAL_HOSTNAME="MVP-W"

# LCD Panel
CONFIG_LCD_PANEL_IO_FORMAT_BUF_SIZE=32
CONFIG_BSP_LCD_DEFAULT_BRIGHTNESS=0
CONFIG_BSP_LCD_PANEL_SPI_TRANS_Q_DEPTH=1
CONFIG_BSP_LCD_SPI_DMA_SIZE_DIV=16

# BLE footprint tuning for single-service GATTS mode
# Keep these close to IDF defaults because the BLE stack also reserves
# internal GAP/GATT services before our custom control service starts.
CONFIG_BT_BTC_TASK_STACK_SIZE=6144
CONFIG_BT_GATT_MAX_SR_PROFILES=8
CONFIG_BT_GATT_MAX_SR_ATTRIBUTES=100
# CONFIG_BT_GATTC_ENABLE is not set
# CONFIG_BT_BLE_SMP_ENABLE is not set
CONFIG_BT_ACL_CONNECTIONS=1
CONFIG_BT_CTRL_BLE_MAX_ACT=2
CONFIG_BT_ALLOCATION_FROM_SPIRAM_FIRST=y
CONFIG_BT_BLE_DYNAMIC_ENV_MEMORY=y

# LVGL Core
CONFIG_LV_CONF_SKIP=y
CONFIG_LV_COLOR_DEPTH_16=y
CONFIG_LV_COLOR_DEPTH=16
CONFIG_LV_COLOR_16_SWAP=y
CONFIG_LV_COLOR_MIX_ROUND_OFS=128
CONFIG_LV_DPI_DEF=130

# LVGL Memory (use PSRAM for large buffers like PNG animations)
CONFIG_LV_MEM_CUSTOM=y
CONFIG_LV_MEM_SIZE_KILOBYTES=1536

# LVGL File System
CONFIG_LV_USE_FS_STDIO=y
CONFIG_LV_FS_STDIO_LETTER=83
CONFIG_LV_FS_STDIO_CACHE_SIZE=0
CONFIG_LV_USE_FS_POSIX=y
CONFIG_LV_FS_POSIX_LETTER=83
CONFIG_LV_FS_POSIX_PATH=""
CONFIG_LV_FS_POSIX_CACHE_SIZE=0

# LVGL PNG decoder
CONFIG_LV_USE_PNG=y
CONFIG_LV_IMG_CACHE_DEF_SIZE=1

# Watcher Animation Service
CONFIG_WATCHER_ANIM_FPS=10
CONFIG_WATCHER_ANIM_RING_FRAMES=4
CONFIG_WATCHER_ANIM_MAX_FRAMES_PER_TYPE=24
CONFIG_WATCHER_ANIM_LAZY_LOAD=y
CONFIG_WATCHER_ANIM_CACHE_RGB565=y
CONFIG_WATCHER_ANIM_WARM_BUDGET_KB=1024
CONFIG_WATCHER_ANIM_HOT_BUDGET_KB=2048
CONFIG_WATCHER_ANIM_SAFETY_MARGIN_KB=512
CONFIG_WATCHER_ANIM_SWITCH_FADE_MS=140
CONFIG_WATCHER_ANIM_DEBUG_PERF=y

# Watcher WebSocket Client
CONFIG_WATCHER_WS_AUDIO_QUEUE_DEPTH=4
CONFIG_WATCHER_WS_AUDIO_STATS_LOG_INTERVAL_FRAMES=60
CONFIG_WATCHER_WS_TTS_QUEUE_DEPTH=32
CONFIG_WATCHER_WS_TTS_MAX_PAYLOAD_BYTES=32768
CONFIG_WATCHER_WS_TTS_ENQUEUE_TIMEOUT_MS=1500
CONFIG_WATCHER_WS_TTS_RX_LOG_INTERVAL_FRAMES=12
CONFIG_WATCHER_WS_TEXT_MAX_PAYLOAD_BYTES=8192

# Watcher SFX Service
CONFIG_WATCHER_SFX_TASK_STACK_SIZE=6144
CONFIG_WATCHER_SFX_STREAM_CHUNK_SIZE=2048

# LVGL Text
CONFIG_LV_TXT_ENC_UTF8=y
CONFIG_LV_USE_USER_DATA=y

# LVGL Assert
CONFIG_LV_USE_ASSERT_NULL=y
CONFIG_LV_USE_ASSERT_MALLOC=y

# LVGL Theme
CONFIG_LV_USE_THEME_DEFAULT=y
CONFIG_LV_THEME_DEFAULT_GROW=y
CONFIG_LV_THEME_DEFAULT_TRANSITION_TIME=80
CONFIG_LV_USE_THEME_BASIC=y

# LVGL Layout
CONFIG_LV_USE_FLEX=y
CONFIG_LV_USE_GRID=y

# LVGL Port (esp_lvgl_port component)
CONFIG_LVGL_DRAW_BUFF_HEIGHT=20
CONFIG_LVGL_PORT_TASK_STACK_SIZE=10240
CONFIG_LVGL_PORT_TASK_PRIORITY=11
CONFIG_LVGL_PORT_TASK_AFFINITY_CPU1=y
CONFIG_LVGL_PORT_TASK_STACK_ALLOC_EXTERNAL=y
CONFIG_SSCMA_PROCESS_TASK_STACK_ALLOC_EXTERNAL=y
CONFIG_SSCMA_MONITOR_TASK_STACK_ALLOC_EXTERNAL=y
CONFIG_SSCMA_ALLOC_SMALL_SHORTTERM_MEM_EXTERNALLY=y
CONFIG_LVGL_PORT_TASK_MAX_SLEEP_MS=5
CONFIG_LVGL_PORT_TIMER_PERIOD_MS=5

# SPI Master
CONFIG_SPI_MASTER=y

# Partition Table (use custom partitions.csv)
CONFIG_PARTITION_TABLE_CUSTOM=y
CONFIG_PARTITION_TABLE_CUSTOM_FILENAME="partitions.csv"

# SPIFFS
CONFIG_SPIFFS_MAX_PARTITIONS=3
CONFIG_SPIFFS_CACHE=y
CONFIG_SPIFFS_CACHE_WR=y
CONFIG_SPIFFS_PAGE_CHECK=y
CONFIG_SPIFFS_GC_MAX_RUNS=10
CONFIG_SPIFFS_PAGE_SIZE=256
CONFIG_SPIFFS_OBJ_NAME_LEN=32
CONFIG_SPIFFS_USE_MAGIC=y
CONFIG_SPIFFS_USE_MAGIC_LENGTH=y
CONFIG_SPIFFS_META_LENGTH=4
CONFIG_SPIFFS_USE_MTIME=y

# LVGL CJK font support for Chinese characters
CONFIG_LV_FONT_SIMSUN_16_CJK=y
CONFIG_LV_FONT_MONTSERRAT_20=y
CONFIG_LV_FONT_MONTSERRAT_22=y
CONFIG_LV_FONT_MONTSERRAT_24=y

# ESP-SR wake word is disabled for V2.3.0 memory headroom.
CONFIG_MODEL_IN_FLASH=y
# CONFIG_USE_WAKENET is not set
# CONFIG_ENABLE_WAKE_WORD is not set
# CONFIG_SR_WN_WN9_NIHAOXIAOZHI_TTS is not set
CONFIG_VOICE_TASK_STACK_SIZE=4096
CONFIG_WAKE_WORD_TASK_STACK_SIZE=4096
CONFIG_WAKE_WORD_TASK_PRIORITY=6
CONFIG_VOICE_AUDIO_STATS_LOG_INTERVAL_FRAMES=60
CONFIG_WAKE_IDLE_STATS_LOG_INTERVAL_FRAMES=120
CONFIG_WAKE_WORD_DET_MODE_95=y
CONFIG_VAD_SILENCE_TIMEOUT_MS=1200
CONFIG_VAD_RMS_THRESHOLD=450
CONFIG_VAD_MIN_SPEECH_MS=600

# ESP-SR Disable offline speech recognition (use cloud via WebSocket)
# This reduces srmodels.bin from 3.9MB to ~300KB
# CONFIG_USE_MULTINET is not set
CONFIG_SR_MN_CN_NONE=y

# LCD debug
CONFIG_LCD_ENABLE_DEBUG_LOG=n
#
# FATFS
#
# CONFIG_FATFS_LFN_NONE is not set
CONFIG_FATFS_LFN_HEAP=y
```

## firmware/esp32-s3/sdkconfig.defaults.stress
```kconfig
CONFIG_WATCHER_STRESS_BUILD=y
CONFIG_WATCHER_STRESS_SERVO_PERIOD_MS=200
CONFIG_WATCHER_STRESS_STATS_PERIOD_MS=5000
```
