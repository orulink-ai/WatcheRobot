## firmware/esp32-s3/main/Kconfig.projbuild
```kconfig
menu "Watcher Logging"

    config WATCHER_RUNTIME_QUIET_LOGS
        bool "Reduce runtime log noise"
        default y
        help
            Raise the runtime default log level to WARN and keep only the main
            control-flow and memory monitor tags at INFO. This keeps heap
            alerts visible while reducing UART noise from other subsystems.

    config WATCHER_LOG_HEAP_DIAGNOSTICS
        bool "Enable heap diagnostic logs"
        default n
        help
            Compile in detailed internal/PSRAM heap snapshot logs used while
            investigating startup and low-memory recovery behavior.

    config WATCHER_CAMERA_VERBOSE_LOGS
        bool "Enable verbose camera diagnostics logs"
        default n
        help
            Compile in HX6538 info/model/catalog diagnostic logging. Disabling
            this removes large format strings and skips extra diagnostic queries.

    config WATCHER_WIFI_REASON_NAME_LOGS
        bool "Enable WiFi disconnect reason name strings"
        default n
        help
            Include human-readable WiFi disconnect reason names in warning logs.
            Disable this to keep only numeric reason codes and save flash/rodata.

    config WATCHER_DEBUG_CLI_ENABLE
        bool "Enable serial debug CLI"
        default n
        help
            Start the developer-only UART debug CLI and its app/settings command
            queue. Disable this for product builds so launcher and Settings do
            not carry the debug task, command queue, or serial command parser.

endmenu

menu "Watcher App.Center"

    config WATCHER_APP_CENTER_ENABLE
        bool "Build App.Center package and OTA application support"
        default n
        help
            Compile App.Center catalog, HTTP download, OTA application, and
            package-transfer support. Keep this disabled in product builds
            that do not expose App.Center so its catalog and runtime state do
            not consume internal RAM or flash.

    if WATCHER_APP_CENTER_ENABLE

    config APP_CENTER_REMOTE_LIST_URL
        string "Remote App.Center list URL"
        default "https://mr-kid-github.github.io/watche-app-center-catalog-test/apps.json"
        help
            HTTP/HTTPS endpoint returning the remote App.Center package list.
            Catalog v2 entries may declare type=firmware-app with firmware
            URL, SHA-256, size, image version, and compatibility metadata.
            Legacy entries without type continue to be treated as 64KB
            manifest packages using packageUrl/downloadUrl/appUrl/url.

    config APP_CENTER_ALLOW_UNSIGNED_DEV_PACKAGES
        bool "Allow unsigned developer app packages"
        default y
        help
            Allow App.Center to install packages without a production signature,
            or packages declaring signature.algorithm as unsigned-dev.
            Keep this enabled for local developer workflows and sample packages.
            Disable it for product builds that should only accept signed or
            trusted-source package metadata.

    config APP_CENTER_TRUSTED_SIGNATURE_ISSUERS
        string "Trusted App.Center signature issuers"
        default ""
        help
            Optional comma-separated issuer allowlist for package signature
            metadata. When this list is not empty, packages declaring a
            production signature algorithm must include signature.issuer and the
            issuer must be present in this list.

    config APP_CENTER_TRUSTED_SIGNATURE_PUBLIC_KEY_SHA256
        string "Trusted App.Center signing public key SHA-256 hashes"
        default ""
        help
            Optional comma-separated SHA-256 hashes of trusted ECDSA P-256 public
            key PEM strings. Production App.Center packages using
            signature.algorithm = "ecdsa-p256-sha256" must include publicKeyPem
            and signature fields, and the SHA-256 hash of publicKeyPem must be
            present in this list.

    endif

endmenu

menu "Watcher Stress"

    config WATCHER_STRESS_BUILD
        bool "Enable dual-MCU stress driver"
        default n
        help
            Compile in the periodic coprocessor stress driver used for the
            10-minute STM32/ESP32 pressure bench.

    config WATCHER_STRESS_SERVO_PERIOD_MS
        int "Stress servo command period (ms)"
        range 50 5000
        default 200
        depends on WATCHER_STRESS_BUILD

    config WATCHER_STRESS_STATS_PERIOD_MS
        int "Stress stats log period (ms)"
        range 500 60000
        default 5000
        depends on WATCHER_STRESS_BUILD

endmenu

menu "Watcher Memory Monitor"

    config WATCHER_LAUNCHER_CACHE_MIN_INTERNAL_FREE_KB
        int "Minimum internal free RAM for Launcher screen cache (KB)"
        range 64 512
        default 112
        help
            Retain the Launcher LVGL tree during foreground handoff only when
            internal free RAM is at or above this threshold.

    config WATCHER_LAUNCHER_CACHE_MIN_INTERNAL_LARGEST_KB
        int "Minimum internal largest block for Launcher screen cache (KB)"
        range 16 256
        default 40

    config WATCHER_LAUNCHER_CACHE_MIN_DMA_LARGEST_KB
        int "Minimum DMA largest block for Launcher screen cache (KB)"
        range 16 256
        default 40

    config WATCHER_MEM_MONITOR_ENABLE
        bool "Enable runtime memory monitor"
        default y
        help
            Start a low-priority task that samples heap usage, emits lifecycle
            snapshots, and warns when internal or DMA headroom becomes tight.

    if WATCHER_MEM_MONITOR_ENABLE

    config WATCHER_MEM_MONITOR_PERIOD_MS
        int "Memory monitor sample period (ms)"
        range 1000 600000
        default 15000
        help
            How often the background monitor samples heap state for warnings.

    config WATCHER_MEM_MONITOR_TASK_STACK_SIZE
        int "Memory monitor task stack size"
        range 1536 8192
        default 4096
        help
            Stack size for the low-priority memory monitor task. The task only
            samples heap counters and is allocated with an external stack when
            PSRAM is enabled.

    config WATCHER_MEM_MONITOR_ALERT_REPEAT_MS
        int "Low-memory alert repeat period (ms)"
        range 1000 3600000
        default 60000
        help
            Minimum interval between repeated low-memory alert logs while the
            system stays in the same warning band.

    config WATCHER_MEM_MONITOR_LOG_STAGE_SNAPSHOTS
        bool "Log lifecycle memory snapshots"
        default y
        help
            Log concise heap snapshots at key boot and recovery stages.

    config WATCHER_MEM_MONITOR_WARN_INTERNAL_FREE_KB
        int "Warn when internal free drops below (KB)"
        range 8 512
        default 40

    config WATCHER_MEM_MONITOR_WARN_INTERNAL_LARGEST_KB
        int "Warn when internal largest block drops below (KB)"
        range 4 256
        default 16

    config WATCHER_MEM_MONITOR_CRITICAL_INTERNAL_FREE_KB
        int "Critical when internal free drops below (KB)"
        range 8 512
        default 28

    config WATCHER_MEM_MONITOR_CRITICAL_INTERNAL_LARGEST_KB
        int "Critical when internal largest block drops below (KB)"
        range 4 256
        default 12

    config WATCHER_MEM_MONITOR_WARN_DMA_LARGEST_KB
        int "Warn when DMA largest block drops below (KB)"
        range 4 256
        default 16

    config WATCHER_MEM_MONITOR_CRITICAL_DMA_LARGEST_KB
        int "Critical when DMA largest block drops below (KB)"
        range 4 256
        default 12

    config WATCHER_MEM_MONITOR_CHECK_INTEGRITY_ON_CRITICAL
        bool "Run heap integrity check during critical pressure"
        default n
        help
            Run heap_caps_check_integrity_all() when the monitor enters the
            critical band, rate-limited by the alert repeat period.

    endif

endmenu
```
